## yocto/meta-hometec/conf/layer.conf
```bitbake
# We have a conf and classes directory, add to BBPATH
BBPATH .= ":${LAYERDIR}"
 
# We have recipes-* directories, add to BBFILES
BBFILES += "${LAYERDIR}/recipes-*/*/*.bb ${LAYERDIR}/recipes-*/*/*.bbappend"
 
BBFILE_COLLECTIONS += "customer"
BBFILE_PATTERN_customer = "^${LAYERDIR}/"
BBFILE_PRIORITY_customer = "1"
 
# This should only be incremented on significant changes that will
# cause compatibility issues with other layers
LAYERVERSION_customer = "1"
 
LAYERDEPENDS_customer = "core"
 
LAYERSERIES_COMPAT_customer = "thud"
```
